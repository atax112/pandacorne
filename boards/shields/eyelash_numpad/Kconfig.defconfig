## boards/shields/eyelash_numpad/Kconfig.defconfig
```kconfig
if SHIELD_EYELASH_NUMPAD
config ZMK_KEYBOARD_NAME
    default "Eyelash Numpad"
config ZMK_BLE
    default y
config ZMK_SPLIT
    default n
#config ZMK_SPLIT_ROLE_CENTRAL
#    default n
#config BT_MAX_CONN
#    default 2
#config BT_MAX_PAIRED
#    default 2
endif
```

## boards/shields/eyelash_numpad/kconfig.defconfig
```kconfig
if SHIELD_EYELASH_NUMPAD
config ZMK_KEYBOARD_NAME
    default "Eyelash Numpad"
config ZMK_BLE
    default y
endif
```
